## main/Kconfig.projbuild
```kconfig
menu "*** CAN bus examples  ***"

    choice
        prompt "Select CAN driver/library"
        default CAN_BACKEND_TWAI
    
    config CAN_BACKEND_TWAI
        bool "Built-in TWAI (SN65HVD230)"
    
    config CAN_BACKEND_MCP2515_SINGLE
        bool "MCP2515 single controller"
    
    config CAN_BACKEND_MCP2515_MULTI
        bool "MCP2515 multi-controller"
    
    endchoice

    choice
    prompt "Select example"
    default EXAMPLE_SEND_SINGLE

    config EXAMPLE_SEND_SINGLE         
        bool "send_single"

    config EXAMPLE_RECV_POLL_SINGLE    
        bool "receive_poll_single"

    config EXAMPLE_RECV_INT_SINGLE
        bool "receive_interrupt_single"
    
    config EXAMPLE_SEND_MULTI
        bool "send_multi"
        depends on CAN_BACKEND_MCP2515_MULTI
    
    config EXAMPLE_RECV_POLL_MULTI
        bool "receive_poll_multi"
        depends on CAN_BACKEND_MCP2515_MULTI
    
    config EXAMPLE_RECV_INT_MULTI      
        bool "receive_interrupt_multi"
        depends on CAN_BACKEND_MCP2515_MULTI
endchoice

endmenu
```
